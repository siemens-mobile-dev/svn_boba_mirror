; _test.inc
;
; This macro preprocessor control file has been generated by TASKING EDE for the 'test' project
;
DEF(_CPU,167)
DEF(_EXT,1)
DEF(_EXTMAC,0)
DEF(_EXT2,0)
DEF(_EXT22,0)
DEF(__STKSZ,0)
DEF(NOBITCLEAR)
DEF(__STDNAMES,reg167.def)


DEF(__XPEN,0)




DEF(__WRCFG,0)
DEF(__CLKEN,0)
DEF(__BYTDIS,0)
DEF(__ROMEN,0)
DEF(__RDYEN0,0)
DEF(__SGTDIS,0)

























DEF(__MCTC,1)

DEF(__RWDC0,0)
DEF(__MTTC,0)


DEF(__ALECTL0,0)
DEF(__BUSACT0,1)

DEF(__RDYEN0,0)

DEF(__CSREN0,0)
DEF(__CSWEN0,0)






















DEF(__BUSACT1,0)













DEF(__BUSACT2,0)













DEF(__BUSACT3,0)













DEF(__BUSACT4,0)











































































DEF(EVA,0)
DEF(EX_AB,0)
DEF(BIT_INIT,0)


DEF(MODEL,LARGE)
DEF(_USRSTACK,0)
DEF(_SINGLE_FP,0)

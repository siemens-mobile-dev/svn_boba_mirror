-carm
// Declare relocation areas for code, constants and data.
-V(CODE)CODE_AREA,12
-V(DATA)DATA_AREA,12
//-U(CODE_AREA)0-FFFFFFFF=(CONST_AREA)0-FFFFFFFF

// Place segments into the relocation areas
-Z(CODE_AREA)DATA_ID,START,CODE,DATA_C,INITTAB,DATA_Z,DATA_N=0-FFFFFFFF
-Z(DATA_AREA)DATA_I=0-FFFFFFFF
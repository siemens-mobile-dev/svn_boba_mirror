-carm
-Z(CODE)START,CODE,SWITAB=A0FD8100-A0FD90FF
-Z(CODE)RET_ADRS=A0FD9000-A0FD90FF
-Z(CONST)INITTAB,DATA_ID,DATA_C=A0FD8100-A0FD90FF
-Z(CODE)HELPER_PROC=A0FD9100-A0FD91FF
-Z(CONST)HELPER_PROC_DATA=A0FD9100-A0FD91FF


//-Z(DATA)DATA_I,DATA_Z,DATA_N=A0078100-A00790FF

-Z(CODE)PATCH_ONCREATE=A1734898-A173489B
-Z(CODE)PATCH_ONCLOSE=A173489C-A173489F

-Z(CODE)PATCH_ESI=A1559B44-A1559B4B


-Z(CODE)PATCH_NO_BROWSE_TXT=A0BE4C94-A0BE4C95
-Z(CODE)PATCH_PROPERTY_WINDOW=A098E9C4-A098E9CF

-Z(CODE)SWILIB_FUNC171=A0FD45C4-A0FD45C7
-Z(CODE)SWILIB_FUNC172=A0FD45C8-A0FD45CB
-Z(CODE)SWILIB_FUNC19C=A0FD4670-A0FD4673
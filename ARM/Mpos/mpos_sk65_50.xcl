-carm
-Z(CODE)START,CODE,SWITAB,INITTAB,DATA_ID,DATA_C=A0FCE200-FFFFFFFF
-Z(CODE)GO_MAIN=A044FDA0-FFFFFFFF

-Z(CODE)PATCH_NET_ICONS=A02A7212-A02A7215
-Z(CODE)PATCH_NET_CANVAS=A02A7208-A02A720B

-Z(CODE)PATCH_Battery_ICONS=A02A7620-A02A7623
-Z(CODE)PATCH_Battery_CANVAS=A02A7616-A02A7619

-Z(CODE)PATCH_Iconbar_x=A02A7556-A02A755B
-Z(CODE)PATCH_Iconbar_y=A02A7570-A02A7573
-Z(CODE)PATCH_Iconbar_CANVAS=A02A9064-A02A9067

-Z(CODE)PATCH_TimeDate=A02C989C-A02C98A3
-carm
-Z(CODE)START,CODE,SWITAB,INITTAB,DATA_ID,DATA_C=A0FCE200-FFFFFFFF
-Z(CODE)GO_MAIN=A04A1790-FFFFFFFF

-Z(CODE)PATCH_NET_ICONS=A02A8CA8-A02A8CAB
-Z(CODE)PATCH_NET_CANVAS=A02A8C9E-A02A8CA2

-Z(CODE)PATCH_Battery_ICONS=A02A9172-A02A9175
-Z(CODE)PATCH_Battery_CANVAS=A02A9150-A02A9153

-Z(CODE)PATCH_Iconbar_x=A02A9090-A02A9095
-Z(CODE)PATCH_Iconbar_y=A02A90AA-A02A90AD
-Z(CODE)PATCH_Iconbar_CANVAS=A02A9064-A02A9067

-Z(CODE)PATCH_TimeDate=A02CCA04-A02CCA0B
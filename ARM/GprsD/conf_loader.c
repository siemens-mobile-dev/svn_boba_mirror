#include "..\inc\swilib.h"
#include "..\inc\cfg_items.h"
#include "conf_loader.h"

// Импорт переменных
extern const char cfgAPN[20];
extern const char cfgUSER[20];
extern const char cfgPASS[20];
extern const unsigned int cfgTimeout;

// Пустышка, все поля забиты нулями
// Используем для инициализации
const char profile_template[0x204] = {
	0x47, 0x50, 0x52, 0x53, 0x2D, 0x30, 0x31, 0x00, 0x00, 0x00, 0x00, 0x00, 0x00, 0x00, 0x00, 0x00, 
	0x00, 0x00, 0x00, 0x00, 0x00, 0x00, 0x00, 0x00, 0x00, 0x00, 0x00, 0x00, 0x00, 0x00, 0x00, 0x00, 
	0x00, 0x00, 0x00, 0x00, 0x00, 0x00, 0x00, 0x00, 0x00, 0x00, 0x00, 0x00, 0x00, 0x00, 0x00, 0x00, 
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	0x00, 0x00, 0x00, 0x00
};

// Заполняет поля профиля
// Вход - указатель на буфер
// Выход - буфер заполнен нужными данными
void FillProfile(char *profile)
{
  memcpy(profile, profile_template, 0x204); // Template => наст.профайл

  // Определяем указатели на поля профиля
  char *apn_place = profile + coAPN_name;
  char *user_place = profile + coLogin;
  char *pass_place = profile + coPass;
  unsigned int *timeout_place =(unsigned int*)(profile + coTimeout);
  
  // Заполняем информацию
  strcpy(user_place, cfgUSER);
  strcpy(pass_place, cfgPASS);
  strcpy(apn_place, cfgAPN);
  memcpy(timeout_place, &cfgTimeout, 4);
//  ShowMSG(1,(int)cfgAPN);
}


// Загрузить конфигурационный файл по пути fname (взято из XTask)
// Конфигурационный загрузчик (c) Rst7
#pragma segment="CONFIG_C"
int LoadConfigData(const char *fname)
{
  int f;
  unsigned int ul;
  char *buf;
  int result=0;
  void *cfg;

  extern const CFG_HDR cfghdr0; //first var in CONFIG
  cfg=(void*)&cfghdr0;

  unsigned int len=(int)__segment_end("CONFIG_C")-(int)__segment_begin("CONFIG_C");

  if (!(buf=malloc(len))) return -1;
  if ((f=fopen(fname,A_ReadOnly+A_BIN,0,&ul))!=-1)
  {
    if (fread(f,buf,len,&ul)==len)
    {
      memcpy(cfg,buf,len);
      fclose(f,&ul);
    }
    else
    {
      fclose(f,&ul);
      goto L_SAVENEWCFG;
    }
  }
  else
  {
  L_SAVENEWCFG:
    if ((f=fopen(fname,A_ReadWrite+A_Create+A_Truncate,P_READ+P_WRITE,&ul))!=-1)
    {
      if (fwrite(f,cfg,len,&ul)!=len) result=-1;
      fclose(f,&ul);
    }
    else
      result=-1;
  }
  mfree(buf);
  return(result);
}

// Инициализация конфигурации
// Надо вызвать в начале работы для загрузки конфигурации
// Поиск конфиг-файла согласно стандарту
void InitConfig()
{
  if(LoadConfigData("4:\\ZBin\\etc\\GprsD.bcfg")<0)
  {
    LoadConfigData("0:\\ZBin\\etc\\GprsD.bcfg");
  }
}

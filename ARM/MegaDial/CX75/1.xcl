-carm
-Z(CODE)START,CODE,SWITAB,DEBUG4,DEBUG3,DEBUG2,DEBUG1,DATA_C=A0FF0070-FFFFFFFF
-Z(CODE)PATCH_ONCREATE=A04A3808-A04A380B
-Z(CODE)PATCH_CSMSIZE=A04A3810-A04A3813
-Z(CODE)PATCH_ONKEY=A04AB370-A04AB373
-Z(CODE)PATCH_RESIZE=A02CB224-A02CB23F
-Z(CODE)PATCH_RESIZE_RET=A02CB240-A02CB240
-Z(CODE)PATCH_KILL_KEY_DOWN=A02CB4D2-A02CB4D3
-Z(CODE)PATCH_ONDRAW=A04AB374-A04AB377
-Z(CODE)PATCH_MAKEFLASH=A0CDCAA0-A0CDCAA3

-Z(CODE)PATCH_ABCHANGED=A060A538-A060A53F


-Z(CONST)INITTAB,DATA_ID=A0FF0100-FFFFFFFF

//-Z(CODE)DEBUG4=A0FF1100-A0FF2100
//-Z(CODE)DEBUG1,DATA_C=A0FF8000-A0FF8FFF
//-Z(CODE)DEBUG2,DEBUG3=A0FF9000-A0FF9FFF

-Z(CODE)PATCH_ESI=A0A8476C-A0A84773

//-Z(DATA)DATA_I,DATA_Z,DATA_N=00000000-FFFFFFFF

-carm
-Z(CODE)START,CODE,SWITAB=A0078100-A0079000
-Z(CODE)RET_ADRS=A0079000-A00790FF
-Z(CONST)INITTAB,DATA_ID,DATA_C=A0078100-A00790FF
-Z(CODE)HELPER_PROC=A0079100-A00791FF
-Z(CONST)HELPER_PROC_DATA=A0079100-A00791FF

//-Z(DATA)DATA_I,DATA_Z,DATA_N=A0078100-A00790FF

-Z(CODE)PATCH_ONCREATE=A042E748-A042E74B
-Z(CODE)PATCH_ONCLOSE=A042E75C-A042E75F
-Z(CODE)PATCH_ESI1=A0902B54-A0902B57
-Z(CODE)PATCH_ESI2=A0902B64-A0902B67
-Z(CODE)PATCH_SHOWMSG_BLF=A065AB30-A065AB33
-Z(CODE)PATCH_TXT_EXT=A067E7EC-A067E7EF

-Z(CODE)SWILIB_FUNC171=A00745C4-A00745C7
-Z(CODE)SWILIB_FUNC172=A00745C8-A00745CB

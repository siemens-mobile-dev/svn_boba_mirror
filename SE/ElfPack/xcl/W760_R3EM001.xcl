-carm
//W760_R3EM001
-Z(CODE)START,CODE,DATA_C,INITTAB=12784000-1278FFFF

-Z(CODE)PATCH_SWI=1017AEF4-1017AEFB
-Z(CODE)LIB=12780000-12783FFF

// инициализация списков
-Z(CODE)PATCH_STANDBY_CALL=10E289D0-10E289D7

// change keyhandler
-Z(CODE)OLD_KEY_HANDLER=4BB7731C-4BB7731F

// ассоциация elf
-Z(CODE)PATCH_DB1=1186FA58-1186FA5F
-Z(CODE)PATCH_DB2=1186F860-1186F867
-Z(CODE)PATCH_DB3=1186F708-1186F70F
-Z(CODE)PATCH_DB4=118700D4-118700DB
-Z(CODE)PATCH_DB5=1186F8AC-1186F8B3
-Z(CODE)PATCH_DB6=1186F8E0-1186F8E7

// инициализация KbdHookList, Helper, Daemons
-Z(CODE)PATCH_AUTO_RUN=11F66908-11F6690B
-Z(CODE)PATCH_AUTO_RUN1=11F6690C-11F6690F

//OseHook
-Z(CODE)PATCH_MMI_MESSAGE_HOOK=112A9B4C-112A9B53

// UIHook
-Z(CODE)PATCH_PageAction=10E88C68-10E88C6F

// PageActionHook
-Z(CODE)PATCH_PageActionImpl=10E891B0-10E891B7

//elfpackdata
-Z(CODE)EPD=4BB9989C-4BB9989F

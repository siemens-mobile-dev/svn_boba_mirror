-carm
//W700_R1CA021
-Z(CODE)START,CODE,DATA_C,INITTAB=451E0000-451E7FFF

-Z(CODE)PATCH_SWI=440670A8-440670AF
-Z(CODE)LIB=451E8000-451EC000


// инициализация списков
-Z(CODE)PATCH_STANDBY_CALL=44EAD724-44EAD72B

// change keyhandler
-Z(CODE)OLD_KEY_HANDLER=4C05DDCC-4C05DDCF

// статическая рама
-Z(DATA)DATA_N=4C04B1DC-4C04B1DF

// ассоциация elf
-Z(CODE)PATCH_DB2=450F26D0-450F26D3
-Z(CODE)PATCH_DB1=450F27F8-450F27FB

// инициализация KbdHookList, Helper, Daemons
-Z(CODE)PATCH_AUTO_RUN=4429D488-4429D48B
-Z(CODE)PATCH_AUTO_RUN1=4429D48C-4429D48F

//OseHook
-Z(CODE)PATCH_MMI_MESSAGE_HOOK=44AE3CF4-44AE3CFD

// UIHook
//-Z(CODE)PATCH_PageAction=45062002-45062005
-Z(CODE)PATCH_PageAction=4506236C-4506236F
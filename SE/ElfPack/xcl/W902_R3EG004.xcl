-carm
//W902_R3EG004
-Z(CODE)START,CODE,DATA_C,INITTAB=12804000-1280FFFF

-Z(CODE)PATCH_SWI=1017AEF4-1017AEFB
-Z(CODE)LIB=12800000-12803FFF

// инициализация списков
-Z(CODE)PATCH_STANDBY_CALL=10D957C4-10D957CB

// change keyhandler
-Z(CODE)OLD_KEY_HANDLER=4BB825FC-4BB825FF

// ассоциация elf
-Z(CODE)PATCH_DB1=117FE29C-117FE2A3
-Z(CODE)PATCH_DB2=117FE0A4-117FE0AB
-Z(CODE)PATCH_DB3=117FDF4C-117FDF53
-Z(CODE)PATCH_DB4=117FE918-117FE91F
-Z(CODE)PATCH_DB5=117FE0F0-117FE0F7
-Z(CODE)PATCH_DB6=117FE124-117FE12B

// инициализация KbdHookList, Helper, Daemons
-Z(CODE)PATCH_AUTO_RUN=11FAD5D4-11FAD5D7
-Z(CODE)PATCH_AUTO_RUN1=11FAD5D8-11FAD5DB

//OseHook
-Z(CODE)PATCH_MMI_MESSAGE_HOOK=11225F18-11225F1F

// UIHook
-Z(CODE)PATCH_PageAction=10DF775C-10DF7763

// PageActionHook
-Z(CODE)PATCH_PageActionImpl=10DF7CA4-10DF7CAB

//elfpackdata
-Z(CODE)EPD=4BBA55EC-4BBA55EF

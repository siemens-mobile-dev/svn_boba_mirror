-carm
//W300_R4EA031
-Z(CODE)START,CODE,DATA_C,INITTAB=45675000-4567CFFF

-Z(CODE)PATCH_SWI=4418E0DC-4418E0E3
-Z(CODE)LIB=4567D000-45681000


// инициализация списков
-Z(CODE)PATCH_STANDBY_CALL=452344C8-452344CF

// change keyhandler
-Z(CODE)OLD_KEY_HANDLER=4C045958-4C04595B

// статическая рама
-Z(DATA)DATA_N=4C02B21C-4C02B21F

// ассоциация elf
-Z(CODE)PATCH_DB2=455432E0-455432E3
-Z(CODE)PATCH_DB1=455433EE-455433F1

// инициализация KbdHookList, Helper, Daemons
-Z(CODE)PATCH_AUTO_RUN=445642BC-445642BF
-Z(CODE)PATCH_AUTO_RUN1=445642C0-445642C3

//OseHook
-Z(CODE)PATCH_MMI_MESSAGE_HOOK=44B72E08-44B72E11

// UIHook
-Z(CODE)PATCH_PageAction=454B8CD4-454B8CD7
-carm
//W810_R4DB005
-Z(CODE)START,CODE,DATA_C,INITTAB=456B8000-456BFFFF

-Z(CODE)PATCH_SWI=441898A4-441898AB
-Z(CODE)LIB=456C0000-456C4000

// инициализация списков
-Z(CODE)PATCH_STANDBY_CALL=452A2764-452A276B


// ассоциация elf
-Z(CODE)PATCH_DB2=455B0308-455B030B
-Z(CODE)PATCH_DB1=455B0416-455B0419

// инициализация KbdHookList, Helper, Daemons
-Z(CODE)PATCH_AUTO_RUN=44560170-44560173
-Z(CODE)PATCH_AUTO_RUN1=44560174-44560177

//OseHook
-Z(CODE)PATCH_MMI_MESSAGE_HOOK=44CF1984-44CF198D

// UIHook
//-Z(CODE)PATCH_PageAction=455264D6-455264D9
-Z(CODE)PATCH_PageAction=45526904-45526907





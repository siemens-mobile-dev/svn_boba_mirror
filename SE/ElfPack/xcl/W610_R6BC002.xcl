-carm
//W610_R6BC002
-Z(CODE)START,CODE,DATA_C,INITTAB=45C30000-45C3FFFF

-Z(CODE)PATCH_SWI=4430C5A8-4430C5B0
-Z(CODE)LIB=45C40000-45C44000

// инициализация списков
-Z(CODE)PATCH_STANDBY_CALL=452B89BC-452B89C3

// change keyhandler
-Z(CODE)OLD_KEY_HANDLER=20050E64-20050E67

// ассоциация elf
-Z(CODE)PATCH_DB1=44EB785C-44EB7863
-Z(CODE)PATCH_DB2=44EB7648-44EB764F
-Z(CODE)PATCH_DB3=44EB74C4-44EB74CD
-Z(CODE)PATCH_DB4=44EB7EB0-44EB7EB7

// инициализация KbdHookList, Helper, Daemons
-Z(CODE)PATCH_AUTO_RUN=45A46BA0-45A46BA3
-Z(CODE)PATCH_AUTO_RUN1=45A46BA4-45A46BA7

//OseHook
-Z(CODE)PATCH_MMI_MESSAGE_HOOK=447AC63C-447AC643

// UIHook
-Z(CODE)PATCH_PageAction=452A47CC-452A47D3

// PageActionHook
-Z(CODE)PATCH_PageActionImpl=452A4DAC-452A4DB3
-carm
//G502_R1FA037_Hutchison
-Z(CODE)START,CODE,DATA_C,INITTAB=12210000-1221FFFF

-Z(CODE)PATCH_SWI=100F2400-100F2408
-Z(CODE)LIB=12220000-12223FFF

// инициализация списков
-Z(CODE)PATCH_STANDBY_CALL=1160F360-1160F367

// change keyhandler
-Z(CODE)OLD_KEY_HANDLER=2A250B6C-2A250B6F

// ассоциация elf
-Z(CODE)PATCH_DB1=1100CC1C
-Z(CODE)PATCH_DB2=1100CA28
-Z(CODE)PATCH_DB3=1100C8E8
-Z(CODE)PATCH_DB4=1100D3F8
-Z(CODE)PATCH_DB5=1100CA74
-Z(CODE)PATCH_DB6=1100CAA8

// инициализация KbdHookList, Helper, Daemons
-Z(CODE)PATCH_AUTO_RUN=11B6FA84-11B6FA87
-Z(CODE)PATCH_AUTO_RUN1=11B6FA88-11B6FA8B

//OseHook
-Z(CODE)PATCH_MMI_MESSAGE_HOOK=107626DC-107626E3

//UIHook
-Z(CODE)PATCH_PageAction=11602B4C-11602B53

// PageActionHook
-Z(CODE)PATCH_PageActionImpl=11603098-1160309F

//elfpackdata
-Z(CODE)EPD=2A2570DC-2A2570DF

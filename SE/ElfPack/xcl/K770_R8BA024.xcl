-carm
//K770_R8BA024
-Z(CODE)START,CODE,DATA_C,INITTAB=45D30000-45D3FFFF

-Z(CODE)PATCH_SWI=44433B84-44433B8C
-Z(CODE)LIB=45D40000-45D44000

// инициализация списков
-Z(CODE)PATCH_STANDBY_CALL=453F5BB0-453F5BB7

// change keyhandler
-Z(CODE)OLD_KEY_HANDLER=20050120-20050123

// ассоциация elf
-Z(CODE)PATCH_DB1=44FECDDC-44FECDE3
-Z(CODE)PATCH_DB2=44FECBC8-44FECBCF
-Z(CODE)PATCH_DB3=44FECA44-44FECA4B
-Z(CODE)PATCH_DB4=44FED430-44FED437

// инициализация KbdHookList, Helper, Daemons
-Z(CODE)PATCH_AUTO_RUN=45CC8920-45CC8923
-Z(CODE)PATCH_AUTO_RUN1=45CC8924-45CC8927

//OseHook
-Z(CODE)PATCH_MMI_MESSAGE_HOOK=448FA87C-448FA883

// UIHook
-Z(CODE)PATCH_PageAction=453E178C-453E1793

// PageActionHook
-Z(CODE)PATCH_PageActionImpl=453E1D6C-453E1D73

//elfpackdata
-Z(CODE)EPD=2005A458-2005A45B

-carm
//K600_R2BB001
-Z(CODE)START,CODE,DATA_C,INITTAB=21468000-2146FFFF

-Z(CODE)PATCH_SWI=200A2354-200A235B
-Z(CODE)LIB=21470000-21473FFF

// инициализация списков
-Z(CODE)PATCH_STANDBY_CALL=20281ECC-20281ED3

// change keyhandler
-Z(CODE)OLD_KEY_HANDLER=28025358-2802535B

// статическая рама
-Z(DATA)DATA_N=2824466C-2824466F

// ассоциация elf
-Z(CODE)PATCH_DB2=204E1FA8-204E1FAF
-Z(CODE)PATCH_DB1=204E20D4-204E20DB

// инициализация KbdHookList, Helper, Daemons
-Z(CODE)PATCH_AUTO_RUN=20F8A9BC-20F8A9BF
-Z(CODE)PATCH_AUTO_RUN1=20F8A9C0-20F8A9C3

//OseHook
-Z(CODE)PATCH_MMI_MESSAGE_HOOK=209627C0-209627C9

// UIHook
-Z(CODE)PATCH_PageAction=20425EFC-20425F03

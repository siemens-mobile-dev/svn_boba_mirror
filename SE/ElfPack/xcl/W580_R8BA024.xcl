-carm
//W580_R8BA024
-Z(CODE)START,CODE,DATA_C,INITTAB=45C30000-45C3FFFF

-Z(CODE)PATCH_SWI=443078D0-443078D8
-Z(CODE)LIB=45C40000-45C44000

// инициализация списков
-Z(CODE)PATCH_STANDBY_CALL=452BFEFC-452BFF03

// change keyhandler
-Z(CODE)OLD_KEY_HANDLER=2004FE04-2004FE07

// ассоциация elf
-Z(CODE)PATCH_DB1=44EAF9F0-44EAF9F7
-Z(CODE)PATCH_DB2=44EAF7DC-44EAF7E3
-Z(CODE)PATCH_DB3=44EAF658-44EAF661
-Z(CODE)PATCH_DB4=44EB0044-44EB004B

// инициализация KbdHookList, Helper, Daemons
-Z(CODE)PATCH_AUTO_RUN=45BA9668-45BA966B
-Z(CODE)PATCH_AUTO_RUN1=45BA966C-45BA966F

//OseHook
-Z(CODE)PATCH_MMI_MESSAGE_HOOK=447B88FC-447B8903

// UIHook
-Z(CODE)PATCH_PageAction=452ABA90-452ABA97

// PageActionHook
-Z(CODE)PATCH_PageActionImpl=452AC070-452AC077

//elfpackdata
-Z(CODE)EPD=2005A3E4-2005A3E7

-carm
//W580_R8BA024
-Z(CODE)START,CODE,DATA_C,INITTAB=45C30000-45C3FFFF

-Z(CODE)PATCH_SWI=443078D0-443078D8
-Z(CODE)LIB=45C40000-45C44000

// инициализация списков
-Z(CODE)PATCH_STANDBY_CALL=452BFEFC-452BFF03

// change keyhandler
-Z(CODE)PATCH_KEYHANDLER1=45355DB4-45355DBB
-Z(CODE)PATCH_KEYHANDLER2=45356210-45356217
-Z(CODE)PATCH_KEYHANDLER3=45356328-4535632F
-Z(CODE)PATCH_KEYHANDLER4=45355E5C-45355E63

// ассоциация elf
-Z(CODE)PATCH_DB1=44EAF9F0-44EAF9F7
-Z(CODE)PATCH_DB2=44EAF7DC-44EAF7E3
-Z(CODE)PATCH_DB3=44EAF658-44EAF661
-Z(CODE)PATCH_DB4=44EB0044-44EB004B

// инициализация KbdHookList, Helper, Daemons
-Z(CODE)PATCH_AUTO_RUN=45BA9668-45BA966B
-Z(CODE)PATCH_AUTO_RUN1=45BA966C-45BA966F

//OseHook
-Z(CODE)PATCH_MMI_MESSAGE_HOOK=447B88FC-447B8903

// PageActionHook
-Z(CODE)PATCH_PageActionImpl_All=452ABFE4-452ABFEB
-Z(CODE)PATCH_PageActionImpl_EnterExit=452ACA20-452ACA27

// TabMenuBar check
-Z(CODE)PATCH_TabMenuCheck=45364664-4536466B

//elfpackdata
-Z(CODE)EPD=2005A3E4-2005A3E7

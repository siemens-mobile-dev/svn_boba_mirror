-carm
//W595_R3EF001
-Z(CODE)START,CODE,DATA_C,INITTAB=127C4000-127CFFFF

-Z(CODE)PATCH_SWI=1017AEF4-1017AEFB
-Z(CODE)LIB=127C0000-127C3FFF

-Z(CODE)PATCH_STANDBY_CALL=10D8D450-10D8D458

// change keyhandler
-Z(CODE)OLD_KEY_HANDLER=4BB76D18-4BB76D1B

// ассоциация elf
-Z(CODE)PATCH_DB1=117DC4D0-117DC4D7
-Z(CODE)PATCH_DB2=117DC2D8-117DC2DF
-Z(CODE)PATCH_DB3=117DC180-117DC187
-Z(CODE)PATCH_DB4=117DCB4C-117DCB53
-Z(CODE)PATCH_DB5=117DC324-117DC32B
-Z(CODE)PATCH_DB6=117DC358-11883CBF

// инициализация KbdHookList, Helper, Daemons
-Z(CODE)PATCH_AUTO_RUN=11EE3D3C-11EE3D3F
-Z(CODE)PATCH_AUTO_RUN1=11EE3D40-11EE3D43

//OseHook
-Z(CODE)PATCH_MMI_MESSAGE_HOOK=1120E0B8-1120E0BF

// UIHook
-Z(CODE)PATCH_PageAction=10DEF7E8-10DEF7EF

// PageActionHook
-Z(CODE)PATCH_PageActionImpl=10DEFD30-10DEFD37

//elfpackdata
-Z(CODE)EPD=4BB99280-4BB99283

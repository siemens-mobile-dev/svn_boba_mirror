-carm
//K850_R1FA035
-Z(CODE)START,CODE,DATA_C,INITTAB=12210000-1221FFFF

-Z(CODE)PATCH_SWI=100EAA6C-100EAA74

-Z(CODE)LIB=12220000-12224000

// инициализация списков
-Z(CODE)PATCH_STANDBY_CALL=115C5B14-115C5B1B

//UIHook
-Z(CODE)PATCH_PageAction=115B9324-115B932B

//OseHook
-Z(CODE)PATCH_MMI_MESSAGE_HOOK=1070CE68-1070CE6F

// change keyhandler
-Z(CODE)OLD_KEY_HANDLER=29C4F43C-29C4F43F

// инициализация KbdHookList, Helper, Daemons
-Z(CODE)PATCH_AUTO_RUN=11B3159C-11B3159F
-Z(CODE)PATCH_AUTO_RUN1=11B315A0-11B315A3

// ассоциация elf
-Z(CODE)PATCH_DB1=10FCE650-10FCE657
-Z(CODE)PATCH_DB2=10FCE69C-10FCE6A3
-Z(CODE)PATCH_DB3=10FCE6D0-10FCE6D7
-Z(CODE)PATCH_DB4=10FCE844-10FCE84B
-Z(CODE)PATCH_DB5=10FCE510-10FCE517
-Z(CODE)PATCH_DB6=10FCF020-10FCF027

-carm
//K800_R8BF003
//-Z(CODE)START,CODE,DATA_C,INITTAB=45C9EE00-45CA5FFF
-Z(CODE)START,CODE,DATA_C,INITTAB=45D10000-45D1FFFF

-Z(CODE)PATCH_SWI=44433DA8-44433DAF
//-Z(CODE)LIB=45CA6000-45CADFFF
-Z(CODE)LIB=45D20000-45D25000

// инициализация списков
-Z(CODE)PATCH_STANDBY_CALL=453C196C-453C1973

// cut print buffer first point
-Z(CODE)CUT_PRINT_BUF1=4423F744-4423F747
-Z(CODE)CUT_PRINT_BUF2=4423F9A8-4423F9AB

// cut print buffer size
-Z(CODE)CUT_PRINT_BUF_SIZE1=4423F9AC-4423F9AF
-Z(CODE)CUT_PRINT_BUF_SIZE2=4423F664-4423F667
-Z(CODE)CUT_PRINT_BUF_SIZE3=4423F740-4423F743

// change keyhandler
-Z(CODE)OLD_KEY_HANDLER=20050B24-20050B27

// статическая рама
-Z(DATA)DATA_N=202E8DE4-202E9DE3

// ассоциация elf
-Z(CODE)PATCH_DB1=44FBCEE8-44FBCEEF
-Z(CODE)PATCH_DB2=44FBCCD4-44FBCCDB
-Z(CODE)PATCH_DB3=44FBCB50-44FBCB57
-Z(CODE)PATCH_DB4=44FBD53C-44FBD543

// инициализация KbdHookList, Helper, Daemons
-Z(CODE)PATCH_AUTO_RUN=45C502EC-45C502EF	
-Z(CODE)PATCH_AUTO_RUN1=45C502F0-45C502F3	

//OseHook
-Z(CODE)PATCH_MMI_MESSAGE_HOOK=448E6210-448E6217

// UIHook
-Z(CODE)PATCH_PageAction=453AD568-453AD56F

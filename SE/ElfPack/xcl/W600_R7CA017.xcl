-carm
//W600_R7CA017
-Z(CODE)START,CODE,DATA_C,INITTAB=45618000-4561FFFF

-Z(CODE)PATCH_SWI=440EFFCC-440EFFD3
-Z(CODE)LIB=45620000-45624000


// инициализация списков
-Z(CODE)PATCH_STANDBY_CALL=451EB5E4-451EB5EB


// change keyhandler
-Z(CODE)OLD_KEY_HANDLER=4C046750-4C046753

// ассоциация elf
-Z(CODE)PATCH_DB2=45501610-45501613
-Z(CODE)PATCH_DB1=4550171E-45501721

// инициализация KbdHookList, Helper, Daemons
-Z(CODE)PATCH_AUTO_RUN=444C353C-444C353F
-Z(CODE)PATCH_AUTO_RUN1=444C3540-444C3543

//OseHook
-Z(CODE)PATCH_MMI_MESSAGE_HOOK=44B39BE8-44B39BF1

// UIHook
-Z(CODE)PATCH_PageAction=4546BCB8-4546BCBB

// PageActionHook
-Z(CODE)PATCH_PageActionImpl=4546B8A4-4546B8AB

//elfpackdata
-Z(CODE)EPD=4C0B7614-4C0B7617

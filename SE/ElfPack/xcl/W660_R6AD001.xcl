-carm
//W660_R6AD001
-Z(CODE)START,CODE,DATA_C,INITTAB=45C30000-45C3FFFF

-Z(CODE)PATCH_SWI=44428E10-44428E18
-Z(CODE)LIB=45C40000-45C44000

// инициализация списков
-Z(CODE)PATCH_STANDBY_CALL=453DA718-453DA71F

// статическая рама
-Z(DATA)DATA_N=202EEC0C-202FEC0B

// cut print buffer first point
-Z(CODE)CUT_PRINT_BUF1=442C97AC-442C97AF
-Z(CODE)CUT_PRINT_BUF2=442C9A10-442C9A13

// cut print buffer size
-Z(CODE)CUT_PRINT_BUF_SIZE1=442C9A14-442C9A17
-Z(CODE)CUT_PRINT_BUF_SIZE2=442C96CC-442C96CF
-Z(CODE)CUT_PRINT_BUF_SIZE3=442C97A8-442C97AB

// change keyhandler
-Z(CODE)OLD_KEY_HANDLER=2004FCD4-2004FCD7

// ассоциация elf
-Z(CODE)PATCH_DB1=44FD1810-44FD1817
-Z(CODE)PATCH_DB2=44FD15FC-44FD1603
-Z(CODE)PATCH_DB3=44FD1478-44FD1481
-Z(CODE)PATCH_DB4=44FD1E68-44FD1E6F

// инициализация KbdHookList, Helper, Daemons
-Z(CODE)PATCH_AUTO_RUN=45BB8FD8-45BB8FDB
-Z(CODE)PATCH_AUTO_RUN1=45BB8FDC-45BB8FDF

//OseHook
-Z(CODE)PATCH_MMI_MESSAGE_HOOK=448C2C1C-448C2C23

// UIHook
-Z(CODE)PATCH_PageAction=453C63CC-453C63D3

-carm
//W660_R6AD001
-Z(CODE)START,CODE,DATA_C,INITTAB=45C30000-45C3FFFF

-Z(CODE)PATCH_SWI=44428E10-44428E18
-Z(CODE)LIB=45C40000-45C44000

// инициализация списков
-Z(CODE)PATCH_STANDBY_CALL=453DA718-453DA71F

// change keyhandler
-Z(CODE)PATCH_KEYHANDLER1=4546F4FC-4546F503
-Z(CODE)PATCH_KEYHANDLER2=4546F930-4546F937
-Z(CODE)PATCH_KEYHANDLER3=4546FA4C-4546FA53
-Z(CODE)PATCH_KEYHANDLER4=4546F5A4-4546F5AB

// ассоциация elf
-Z(CODE)PATCH_DB1=44FD1810-44FD1817
-Z(CODE)PATCH_DB2=44FD15FC-44FD1603
-Z(CODE)PATCH_DB3=44FD1478-44FD1481
-Z(CODE)PATCH_DB4=44FD1E68-44FD1E6F

// инициализация KbdHookList, Helper, Daemons
-Z(CODE)PATCH_AUTO_RUN=45BB8FD8-45BB8FDB
-Z(CODE)PATCH_AUTO_RUN1=45BB8FDC-45BB8FDF

//OseHook
-Z(CODE)PATCH_MMI_MESSAGE_HOOK=448C2C1C-448C2C23

// PageActionHook
-Z(CODE)PATCH_PageActionImpl_All=453C6920-453C6927
-Z(CODE)PATCH_PageActionImpl_EnterExit=453C735C-453C7363

// TabMenuBar check
-Z(CODE)PATCH_TabMenuCheck=4547DDC0-4547DDC7

//elfpackdata
-Z(CODE)EPD=2005A220-2005A223

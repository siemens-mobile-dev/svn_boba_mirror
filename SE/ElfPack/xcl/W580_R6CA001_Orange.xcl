-carm
//W580_R6ca001_Orange
-Z(CODE)START,CODE,DATA_C,INITTAB=45CF0000-45CFFFFF

-Z(CODE)PATCH_SWI=44306EF4-44306EFB
-Z(CODE)LIB=45D00000-45D04000

// инициализация списков
-Z(CODE)PATCH_STANDBY_CALL=452EF0CC-452EF0D3

// статическая рама
-Z(DATA)DATA_N=202FA870-202FB86F

// cut print buffer first point
-Z(CODE)CUT_PRINT_BUF1=44236C60-44236C63
-Z(CODE)CUT_PRINT_BUF2=44236EC4-44236EC7

// cut print buffer size
-Z(CODE)CUT_PRINT_BUF_SIZE1=44236EC8-44236ECB
-Z(CODE)CUT_PRINT_BUF_SIZE2=44236B80-44236B83
-Z(CODE)CUT_PRINT_BUF_SIZE3=44236C5C-44236C5F

// change keyhandler
-Z(CODE)OLD_KEY_HANDLER=2004FD38-2004FD3B

// ассоциация elf
-Z(CODE)PATCH_DB1=44EDAA0C-44EDAA13
-Z(CODE)PATCH_DB2=44EDA7F8-44EDA7FF
-Z(CODE)PATCH_DB3=44EDA674-44EDA67D
-Z(CODE)PATCH_DB4=44EDB060-44EDB067

// инициализация KbdHookList, Helper, Daemons
-Z(CODE)PATCH_AUTO_RUN=45BAD804-45BAD807
-Z(CODE)PATCH_AUTO_RUN1=45BAD808-45BAD80B

//OseHook
-Z(CODE)PATCH_MMI_MESSAGE_HOOK=447BE61C-447BE623

// UIHook
-Z(CODE)PATCH_PageAction=452DACE0-452DACE7
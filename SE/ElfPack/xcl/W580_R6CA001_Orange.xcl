-carm
//W580_R6ca001_Orange
-Z(CODE)START,CODE,DATA_C,INITTAB=45CF0000-45CFFFFF

-Z(CODE)PATCH_SWI=44306EF4-44306EFB
-Z(CODE)LIB=45D00000-45D04000

// инициализация списков
-Z(CODE)PATCH_STANDBY_CALL=452EF0CC-452EF0D3

// change keyhandler
-Z(CODE)OLD_KEY_HANDLER=2004FD38-2004FD3B

// ассоциация elf
-Z(CODE)PATCH_DB1=44EDAA0C-44EDAA13
-Z(CODE)PATCH_DB2=44EDA7F8-44EDA7FF
-Z(CODE)PATCH_DB3=44EDA674-44EDA67D
-Z(CODE)PATCH_DB4=44EDB060-44EDB067

// инициализация KbdHookList, Helper, Daemons
-Z(CODE)PATCH_AUTO_RUN=45BAD804-45BAD807
-Z(CODE)PATCH_AUTO_RUN1=45BAD808-45BAD80B

//OseHook
-Z(CODE)PATCH_MMI_MESSAGE_HOOK=447BE61C-447BE623

// UIHook
-Z(CODE)PATCH_PageAction=452DACE0-452DACE7

// PageActionHook
-Z(CODE)PATCH_PageActionImpl=452DB2C0-452DB2C7

//elfpackdata
-Z(CODE)EPD=2005A2EC-2005A2EF

-carm
//W880_R8BA024
-Z(CODE)START,CODE,DATA_C,INITTAB=45D00000-45D07FFF

-Z(CODE)PATCH_SWI=4442B8A0-4442B8A7
-Z(CODE)LIB=45D08000-45D0BFFF

// инициализация списков
-Z(CODE)PATCH_STANDBY_CALL=453D9D68-453D9D6F

// статическая рама
-Z(DATA)DATA_N=202EEB84-202EFB83

// cut print buffer first point
-Z(CODE)CUT_PRINT_BUF1=442CA9E4-442CA9E7
-Z(CODE)CUT_PRINT_BUF2=442CAC48-442CAC4B

// cut print buffer size
-Z(CODE)CUT_PRINT_BUF_SIZE1=442CAC4C-442CAC4F
-Z(CODE)CUT_PRINT_BUF_SIZE2=442CA904-442CA907
-Z(CODE)CUT_PRINT_BUF_SIZE3=442CA9E0-442CA9E3

// change keyhandler
-Z(CODE)OLD_KEY_HANDLER=2004FB10-2004FB13

// ассоциация elf
-Z(CODE)PATCH_DB1=44FD78C4-44FD78CB
-Z(CODE)PATCH_DB2=44FD76B0-44FD76B7
-Z(CODE)PATCH_DB3=44FD752C-44FD7535
-Z(CODE)PATCH_DB4=44FD7F18-44FD7F1F

// инициализация KbdHookList, Helper, Daemons
-Z(CODE)PATCH_AUTO_RUN=45CA06E8-45CA06EB
-Z(CODE)PATCH_AUTO_RUN1=45CA06EC-45CA06EF

//OseHook
-Z(CODE)PATCH_MMI_MESSAGE_HOOK=448E8568-448E856F

// UIHook
-Z(CODE)PATCH_PageAction=453C5908-453C590F

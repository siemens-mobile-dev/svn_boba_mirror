-carm
//Z550_R6CA009
-Z(CODE)START,CODE,DATA_C,INITTAB=456B8000-456BFFFF

-Z(CODE)PATCH_SWI=4418449C-441844A3
-Z(CODE)LIB=456C0000-456C4000


// инициализация списков
-Z(CODE)PATCH_STANDBY_CALL=45264218-4526421F

// change keyhandler
-Z(CODE)OLD_KEY_HANDLER=4C045358-4C04535B

// ассоциация elf
-Z(CODE)PATCH_DB2=4555BF2C-4555BF2F
-Z(CODE)PATCH_DB1=4555C03A-4555C03D

// инициализация KbdHookList, Helper, Daemons
-Z(CODE)PATCH_AUTO_RUN=44558AF0-44558AF3
-Z(CODE)PATCH_AUTO_RUN1=44558AF4-44558AF7

//OseHook
-Z(CODE)PATCH_MMI_MESSAGE_HOOK=44B9A204-44B9A20D

// UIHook
-Z(CODE)PATCH_PageAction=454DE948-454DE94B

// PageActionHook
-Z(CODE)PATCH_PageActionImpl=454DE534-454DE53B

//elfpackdata
-Z(CODE)EPD=4C06DCE4-4C06DCE7


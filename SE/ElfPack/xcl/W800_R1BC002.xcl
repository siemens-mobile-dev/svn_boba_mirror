-carm
//W800_R1BC002
-Z(CODE)START,CODE,DATA_C,INITTAB=45218000-4521FFFF

-Z(CODE)PATCH_SWI=440670B4-440670BB
-Z(CODE)LIB=45220000-45224000


// инициализация списков
-Z(CODE)PATCH_STANDBY_CALL=44EA7710-44EA7717

// change keyhandler
-Z(CODE)OLD_KEY_HANDLER=4C05DD44-4C05DD47

// статическая рама
-Z(DATA)DATA_N=4C04B0C8-4C04B0CB

// ассоциация elf
-Z(CODE)PATCH_DB2=450EBB04-450EBB07
-Z(CODE)PATCH_DB1=450EBC2C-450EBC2F

// инициализация KbdHookList, Helper, Daemons
-Z(CODE)PATCH_AUTO_RUN=4429CE04-4429CE07
-Z(CODE)PATCH_AUTO_RUN1=4429CE08-4429CE0B

//OseHook
-Z(CODE)PATCH_MMI_MESSAGE_HOOK=448F393C-448F3945

// UIHook
//-Z(CODE)PATCH_PageAction=4505B442-4505B445
-Z(CODE)PATCH_PageAction=4505B7AC-4505B7AF


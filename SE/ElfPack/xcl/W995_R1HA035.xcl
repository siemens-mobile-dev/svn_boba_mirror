-carm
//W995_R1HA035
-Z(CODE)START,CODE,DATA_C,INITTAB=15E2EF00-15E51EFF

-Z(CODE)PATCH_SWI=101E27C4-101E27CB
-Z(CODE)LIB=15E2AF00-15E2EEFF

// инициализация списков
-Z(CODE)PATCH_STANDBY_CALL=14E30C94-14E30C9B

// change keyhandler
-Z(CODE)OLD_KEY_HANDLER=4BA02A80-4BA02A83

// ассоциация elf
-Z(CODE)PATCH_DB1=142DBA94
-Z(CODE)PATCH_DB2=142DBE8C
-Z(CODE)PATCH_DB3=14FC8030
-Z(CODE)PATCH_DB4=14FF113C


// инициализация KbdHookList, Helper, Daemons
-Z(CODE)PATCH_AUTO_RUN=15D14708-15D1470B
-Z(CODE)PATCH_AUTO_RUN1=15D1470C-15D1470F

//OseHook
-Z(CODE)PATCH_MMI_MESSAGE_HOOK=10137520-10137527

//UIHook
-Z(CODE)PATCH_PageAction=141044D8-141044DF

// PageActionHook
-Z(CODE)PATCH_PageActionImpl=14103F8C-14103F93

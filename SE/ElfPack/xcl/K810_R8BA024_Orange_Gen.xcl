-carm
//K810_R8BA024_Orange_Gen
-Z(CODE)START,CODE,DATA_C,INITTAB=45CE3B30-45CECB2F

-Z(CODE)PATCH_SWI=44433B1C-44433B23
-Z(CODE)LIB=45CECB30-45CF0B2F

// инициализация списков
-Z(CODE)PATCH_STANDBY_CALL=45407C44-45407C4B

// статическая рама
-Z(DATA)DATA_N=202F0EB4-202F1EB3

// cut print buffer first point
-Z(CODE)CUT_PRINT_BUF1=442D0E28-442D0E2B
-Z(CODE)CUT_PRINT_BUF2=442D108C-442D108F

// cut print buffer size
-Z(CODE)CUT_PRINT_BUF_SIZE1=442D1090-442D1093
-Z(CODE)CUT_PRINT_BUF_SIZE2=442D0D48-442D0D4B
-Z(CODE)CUT_PRINT_BUF_SIZE3=442D0E24-442D0E27

// change keyhandler
-Z(CODE)OLD_KEY_HANDLER=20050B24-20050B27

// ассоциация elf
-Z(CODE)PATCH_DB1=44FFA908-44FFA90F
-Z(CODE)PATCH_DB2=44FFA6F4-44FFA6FB
-Z(CODE)PATCH_DB3=44FFA570-44FFA577
-Z(CODE)PATCH_DB4=44FFAF5C-44FFAF63

// инициализация KbdHookList, Helper, Daemons
-Z(CODE)PATCH_AUTO_RUN=45C94698-45C9469B
-Z(CODE)PATCH_AUTO_RUN1=45C9469C-45C9469F

//OseHook
-Z(CODE)PATCH_MMI_MESSAGE_HOOK=449234DC-449234E3

// UIHook
-Z(CODE)PATCH_PageAction=453F381C-453F3823
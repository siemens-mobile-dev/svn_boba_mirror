-carm
//Z610_R6DA001
-Z(CODE)START,CODE,DATA_C,INITTAB=45B80E00-45B87FFF

-Z(CODE)PATCH_SWI=4442947C-44429483
-Z(CODE)LIB=45B88000-45B8FFFF

// инициализация списков
-Z(CODE)PATCH_STANDBY_CALL=45393204-4539320B

// change keyhandler
-Z(CODE)OLD_KEY_HANDLER=2004F468-2004F46B

// ассоциация elf
-Z(CODE)PATCH_DB1=44FA35A4-44FA35AB
-Z(CODE)PATCH_DB2=44FA3390-44FA3397
-Z(CODE)PATCH_DB3=44FA320C-44FA3213
-Z(CODE)PATCH_DB4=44FA3BF8-44FA3BFF

// инициализация KbdHookList, Helper, Daemons
-Z(CODE)PATCH_AUTO_RUN=45B3223C-45B3223F
-Z(CODE)PATCH_AUTO_RUN1=45B32240-45B32243

//OseHook
-Z(CODE)PATCH_MMI_MESSAGE_HOOK=448C2DC8-448C2DCF

// UIHook
-Z(CODE)PATCH_PageAction=4537E850-4537E857

// PageActionHook
-Z(CODE)PATCH_PageActionImpl=4537EE30-4537EE37

// TabMenuBar check
-Z(CODE)PATCH_TabMenuCheck=45436DCC-45436DD3

//elfpackdata
-Z(CODE)EPD=2005956C-2005956F

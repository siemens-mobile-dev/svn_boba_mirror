-carm
//Z610_R6DA001
-Z(CODE)START,CODE,DATA_C,INITTAB=45B80E00 //-45B8FFFF???

-Z(CODE)PATCH_SWI=4442947C //-44429483
-Z(CODE)LIB=45B88000-45B8BFFF

// инициализация списков
-Z(CODE)PATCH_STANDBY_CALL=45393204 //-4539320B

// cut print buffer first point
-Z(CODE)CUT_PRINT_BUF1=4423E634 //-4423E637
-Z(CODE)CUT_PRINT_BUF2=4423E898 //-4423E89B

// cut print buffer size
-Z(CODE)CUT_PRINT_BUF_SIZE1=4423E89C //-4423E89F
-Z(CODE)CUT_PRINT_BUF_SIZE2=4423E554 //-4423E557
-Z(CODE)CUT_PRINT_BUF_SIZE3=4423E630 //-4423E633

// change keyhandler
-Z(CODE)OLD_KEY_HANDLER=2004F468-2004F46B

// статическая рама
-Z(DATA)DATA_N=202E6750-202E774F

// ассоциация elf
-Z(CODE)PATCH_DB1=44FA35A4 //-44FA35AB
-Z(CODE)PATCH_DB2=44FA3390 //-44FA3397
-Z(CODE)PATCH_DB3=44FA320C //-44FA3213
-Z(CODE)PATCH_DB4=44FA3BF8 //-44FA3BFF

// инициализация KbdHookList, Helper, Daemons
-Z(CODE)PATCH_AUTO_RUN=45B3223C //-45B3223F
-Z(CODE)PATCH_AUTO_RUN1=45B32240 //-45B32243

//OseHook
-Z(CODE)PATCH_MMI_MESSAGE_HOOK=448C2DC8 //-448C2DCF

// UIHook
-Z(CODE)PATCH_PageAction=4537E850 //-4537E857

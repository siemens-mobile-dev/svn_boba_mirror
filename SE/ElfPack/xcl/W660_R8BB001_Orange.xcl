-carm
//W660_R8BB001_Orange
-Z(CODE)START,CODE,DATA_C,INITTAB=45D40000-45D4FFFF

-Z(CODE)PATCH_SWI=4442B808-4442B880
-Z(CODE)LIB=45D50000-45D54000

// инициализация списков
-Z(CODE)PATCH_STANDBY_CALL=45424A44-45424A4B

// статическая рама
-Z(DATA)DATA_N=202EF2D8-202FF2D7

// cut print buffer first point
-Z(CODE)CUT_PRINT_BUF1=442CABCC-442CABCF
-Z(CODE)CUT_PRINT_BUF2=442CAE30-442CAE33

// cut print buffer size
-Z(CODE)CUT_PRINT_BUF_SIZE1=442CAE34-442CAE37
-Z(CODE)CUT_PRINT_BUF_SIZE2=442CAAEC-442CAAEF
-Z(CODE)CUT_PRINT_BUF_SIZE3=442CABC8-442CABCB

// change keyhandler
-Z(CODE)OLD_KEY_HANDLER=2004FF54-2004FF57

// ассоциация elf
-Z(CODE)PATCH_DB1=4500EB64-4500EB6B
-Z(CODE)PATCH_DB2=4500E950-4500E957
-Z(CODE)PATCH_DB3=4500E7CC-4500E7D5
-Z(CODE)PATCH_DB4=4500F1B8-4500F1BF

// инициализация KbdHookList, Helper, Daemons
-Z(CODE)PATCH_AUTO_RUN=45C00480-45C00483
-Z(CODE)PATCH_AUTO_RUN1=45C00484-45C00487

//OseHook
-Z(CODE)PATCH_MMI_MESSAGE_HOOK=44910C74-44910C7B

// UIHook
-Z(CODE)PATCH_PageAction=45410630-45410637

// TabMenuBar check
-Z(CODE)PATCH_TabMenuCheck=454C8190-454C8197
-carm
//K810_R8BA024
-Z(CODE)START,CODE,DATA_C,INITTAB=45CBB200-45CCB1FF

-Z(CODE)PATCH_SWI=4443388C-44433893
-Z(CODE)LIB=45CCB200-45CD0200

// инициализация списков
-Z(CODE)PATCH_STANDBY_CALL=453CC1F4-453CC1FB

// статическая рама
-Z(DATA)DATA_N=202F0D18-202F1D17

// cut print buffer first point
-Z(CODE)CUT_PRINT_BUF1=442D0D30-442D0D33
-Z(CODE)CUT_PRINT_BUF2=442D0F94-442D0F97

// cut print buffer size
-Z(CODE)CUT_PRINT_BUF_SIZE1=442D0F98-442D0F9B
-Z(CODE)CUT_PRINT_BUF_SIZE2=442D0C50-442D0C53
-Z(CODE)CUT_PRINT_BUF_SIZE3=442D0D2C-442D0D2F

// change keyhandler
-Z(CODE)OLD_KEY_HANDLER=20050B24-20050B27

// ассоциация elf
-Z(CODE)PATCH_DB1=44FC5ABC-44FC5AC3
-Z(CODE)PATCH_DB2=44FC58A8-44FC58AF
-Z(CODE)PATCH_DB3=44FC5724-44FC572B
-Z(CODE)PATCH_DB4=44FC6110-44FC6117

// инициализация KbdHookList, Helper, Daemons
-Z(CODE)PATCH_AUTO_RUN=45C64284-45C64287
-Z(CODE)PATCH_AUTO_RUN1=45C64288-45C6428B

//OseHook
-Z(CODE)PATCH_MMI_MESSAGE_HOOK=448FAA48-448FAA4F

// UIHook
-Z(CODE)PATCH_PageAction=453B7DDC-453B7DE3
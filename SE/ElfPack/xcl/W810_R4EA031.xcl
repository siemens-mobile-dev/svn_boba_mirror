-carm
//W810_R4EA031
-Z(CODE)START,CODE,DATA_C,INITTAB=456B8000-456BFFFF//456BFFFF

-Z(CODE)PATCH_SWI=4418BBDC-4418BBE3
-Z(CODE)LIB=456C0000-456C4000


// инициализация списков
-Z(CODE)PATCH_STANDBY_CALL=452AC494-452AC49B

// change keyhandler
-Z(CODE)OLD_KEY_HANDLER=4C045A34-4C045A37

// статическая рама
-Z(DATA)DATA_N=4C02C7C4-4C02C7C7

// ассоциация elf
-Z(CODE)PATCH_DB2=455BAE48-455BAE4B
-Z(CODE)PATCH_DB1=455BAF56-455BAF59

// инициализация KbdHookList, Helper, Daemons
-Z(CODE)PATCH_AUTO_RUN=44564944-44564947
-Z(CODE)PATCH_AUTO_RUN1=44564948-4456494B

//OseHook
-Z(CODE)PATCH_MMI_MESSAGE_HOOK=44C1B034-44C1B03D

// UIHook
//-Z(CODE)PATCH_PageAction=45530FB2-45530FB5
-Z(CODE)PATCH_PageAction=455313E0-455313E3





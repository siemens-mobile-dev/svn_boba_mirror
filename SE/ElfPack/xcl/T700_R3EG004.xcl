-carm
//T700_R3EG004
-Z(CODE)START,CODE,DATA_C,INITTAB=12644000-1264FFFF

-Z(CODE)PATCH_SWI=0x1017AEF8-1017AEFF
-Z(CODE)LIB=12640000-12643FFF

// инициализация списков
-Z(CODE)PATCH_STANDBY_CALL=10D64F90-10D64F97

// change keyhandler
-Z(CODE)OLD_KEY_HANDLER=4BB77038-4BB7703B

// ассоциация elf
-Z(CODE)PATCH_DB1=117B87EC-117B87F3
-Z(CODE)PATCH_DB2=117B85F4-117B85FB
-Z(CODE)PATCH_DB3=117B849C-117B84A3
-Z(CODE)PATCH_DB4=117B8E68-117B8E6F
-Z(CODE)PATCH_DB5=117B8640-117B8647
-Z(CODE)PATCH_DB6=117B8674-117B867B

// инициализация KbdHookList, Helper, Daemons
-Z(CODE)PATCH_AUTO_RUN=11EBA578-11EBA57B
-Z(CODE)PATCH_AUTO_RUN1=11EBA57C-11EBA57F

//OseHook
-Z(CODE)PATCH_MMI_MESSAGE_HOOK=111E8344-111E834B

// UIHook
-Z(CODE)PATCH_PageAction=10DC6F0C-10DC6F13

// PageActionHook
-Z(CODE)PATCH_PageActionImpl=10DC7454-10DC745B

//elfpackdata
-Z(CODE)EPD=4BB99134-4BB99137

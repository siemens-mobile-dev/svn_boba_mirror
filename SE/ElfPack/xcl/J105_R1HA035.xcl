-carm
//C510_R1HA035
-Z(CODE)START,CODE,DATA_C,INITTAB=15C89000-15C8FFFF

-Z(CODE)PATCH_SWI=101E7364-101E736B
-Z(CODE)LIB=15C90000-15CAFFFF

// инициализация списков
-Z(CODE)PATCH_STANDBY_CALL=1444D3B8-1444D3BF

// change keyhandler
-Z(CODE)OLD_KEY_HANDLER=4BA02AE8-4BA02AEB

// ассоциация elf
-Z(CODE)PATCH_DB1=144DC2E8-144DC2EF
-Z(CODE)PATCH_DB2=144DBEF4-144DBEFB
-Z(CODE)PATCH_DB3=14EF8ABC-14EF8AC3
-Z(CODE)PATCH_DB4=1442437C-14424383


// инициализация KbdHookList, Helper, Daemons
-Z(CODE)PATCH_AUTO_RUN=15B00CD0-15B00CD3
-Z(CODE)PATCH_AUTO_RUN1=15B00CD4-15B00CDB

//OseHook
-Z(CODE)PATCH_MMI_MESSAGE_HOOK=10134310-10134317

//UIHook
-Z(CODE)PATCH_PageAction=14026224-1402622B

// PageActionHook
-Z(CODE)PATCH_PageActionImpl=14026760-14026767

//Str2ID fix
-Z(CODE)PATCH_Str2ID=14227422-14227423

//int2strID fix
-Z(CODE)PATCH_int2strID=14522D22-14522D23
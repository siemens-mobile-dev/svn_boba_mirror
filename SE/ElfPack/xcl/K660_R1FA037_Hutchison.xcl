-carm

//K660_R1FA037_Hutchison
-Z(CODE)START,CODE,DATA_C,INITTAB=12190000-12196FFF

-Z(CODE)PATCH_SWI=100F23F8-100F23FF
-Z(CODE)LIB=12197000-121B6FFF

// инициализация списков
-Z(CODE)PATCH_STANDBY_CALL=1161155C-11611563

// change keyhandler
-Z(CODE)OLD_KEY_HANDLER=2A250B64-2A250B67

// ассоциация elf
-Z(CODE)PATCH_DB1=1100E12C-1100E133
-Z(CODE)PATCH_DB2=1100DF38-1100DF3F
-Z(CODE)PATCH_DB3=1100DDF8-1100DDFF
-Z(CODE)PATCH_DB4=1100E908-1100E90F
-Z(CODE)PATCH_DB5=1100DF84-1100DF8B
-Z(CODE)PATCH_DB6=1100DFB8-1100DFBF

// инициализация KbdHookList, Helper, Daemons
-Z(CODE)PATCH_AUTO_RUN=11B72004-11B72007
-Z(CODE)PATCH_AUTO_RUN1=11B72008-11B7200B

//OseHook
-Z(CODE)PATCH_MMI_MESSAGE_HOOK=107626D8-107626E1

// UIHook
-Z(CODE)PATCH_PageAction=11604D5C-11604D65
// PageActionHook
-Z(CODE)PATCH_PageActionImpl=116052AC-116052B3
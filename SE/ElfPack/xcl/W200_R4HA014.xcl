-carm
//W200_R4HA014
-Z(CODE)START,CODE,DATA_C,INITTAB=456B8000-456BFFFF//456BFFFF

-Z(CODE)PATCH_SWI=441824B4-441824BB
-Z(CODE)LIB=456C0000-456C4000


// инициализация списков
-Z(CODE)PATCH_STANDBY_CALL=45120544-4512054B

// change keyhandler
-Z(CODE)OLD_KEY_HANDLER=4C044D48-4C044D4B //

// ассоциация elf
-Z(CODE)PATCH_DB2=4542D404-4542D407
-Z(CODE)PATCH_DB1=4542D512-4542D515

// инициализация KbdHookList, Helper, Daemons
-Z(CODE)PATCH_AUTO_RUN=444CB3F8-444CB3FB
-Z(CODE)PATCH_AUTO_RUN1=444CB3FC-444CB3FF

//OseHook
-Z(CODE)PATCH_MMI_MESSAGE_HOOK=44A562B8-44A562C1

// UIHook
//-Z(CODE)PATCH_PageAction=4539DB22-4539DB25
-Z(CODE)PATCH_PageAction=4539DF50-4539DF53

// PageActionHook
-Z(CODE)PATCH_PageActionImpl=4539DB3C-4539DB43
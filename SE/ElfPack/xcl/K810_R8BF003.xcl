-carm
//K810_R8BF003
-Z(CODE)START,CODE,DATA_C,INITTAB=45D40000-45D4FFFF

-Z(CODE)PATCH_SWI=44433F28-44433F2F
-Z(CODE)LIB=45D50000-45D55000

// инициализация списков
-Z(CODE)PATCH_STANDBY_CALL=453CDE00-453CDE07

// change keyhandler
-Z(CODE)OLD_KEY_HANDLER=20050B24-20050B27

// ассоциация elf
-Z(CODE)PATCH_DB1=44FC6844-44FC684B
-Z(CODE)PATCH_DB2=44FC6630-44FC6637
-Z(CODE)PATCH_DB3=44FC64AC-44FC64B3
-Z(CODE)PATCH_DB4=44FC6E98-44FC6E9F

// инициализация KbdHookList, Helper, Daemons
-Z(CODE)PATCH_AUTO_RUN=45C66EAC-45C66EAF
-Z(CODE)PATCH_AUTO_RUN1=45C66EB0-45C66EB3

//OseHook
-Z(CODE)PATCH_MMI_MESSAGE_HOOK=448EF90C-448EF913

// UIHook
-Z(CODE)PATCH_PageAction=453B9A00-453B9A07

// PageActionHook
-Z(CODE)PATCH_PageActionImpl=453B9FE0-453B9FE7

//elfpackdata
-Z(CODE)EPD=2005AF80-2005AF83

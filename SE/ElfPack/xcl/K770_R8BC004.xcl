-carm
//K770_R8BC004
-Z(CODE)START,CODE,DATA_C,INITTAB=45D20000-45D2FFFF

-Z(CODE)PATCH_SWI=44433EEC-44433EF4
-Z(CODE)LIB=45D30000-45D34000

// инициализация списков
-Z(CODE)PATCH_STANDBY_CALL=453F7758-453F775F

// change keyhandler
-Z(CODE)OLD_KEY_HANDLER=20050124-20050127

// ассоциация elf
-Z(CODE)PATCH_DB1=44FEDAB4-44FEDABB
-Z(CODE)PATCH_DB2=44FED8A0-44FED8A7
-Z(CODE)PATCH_DB3=44FED71C-44FED723
-Z(CODE)PATCH_DB4=44FEE108-44FEE10F

// инициализация KbdHookList, Helper, Daemons
-Z(CODE)PATCH_AUTO_RUN=45CCB980-45CCB983
-Z(CODE)PATCH_AUTO_RUN1=45CCB984-45CCB987

//OseHook
-Z(CODE)PATCH_MMI_MESSAGE_HOOK=448EF408-448EF40F

// UIHook
-Z(CODE)PATCH_PageAction=453E333C-453E3343

// PageActionHook
-Z(CODE)PATCH_PageActionImpl=453E391C-453E3923

//elfpackdata
-Z(CODE)EPD=2005A458-2005A45B

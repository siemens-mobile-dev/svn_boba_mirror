-carm
//Z530_R6DA001
-Z(CODE)START,CODE,DATA_C,INITTAB=456B8000-456BFFFF

-Z(CODE)PATCH_SWI=4418449C-441844A3
-Z(CODE)LIB=456C0000-456C4000


// инициализация списков
-Z(CODE)PATCH_STANDBY_CALL=451DC668-451DC66F

// change keyhandler
-Z(CODE)OLD_KEY_HANDLER=4C045144-4C045147

// статическая рама
-Z(DATA)DATA_N=4C02D580-4C02D583

// ассоциация elf
-Z(CODE)PATCH_DB2=454D1B68-454D1B6B
-Z(CODE)PATCH_DB1=454D1C76-454D1C79

// инициализация KbdHookList, Helper, Daemons
-Z(CODE)PATCH_AUTO_RUN=44555758-4455575B
-Z(CODE)PATCH_AUTO_RUN1=4455575C-4455575F

//OseHook
-Z(CODE)PATCH_MMI_MESSAGE_HOOK=44B16078-44B16081

// UIHook
-Z(CODE)PATCH_PageAction=45454540-45454543

/*
	Thanks to GPcH for sponsoring this hard work
*/

-carm
//K790_R8BF003
-Z(CODE)START,CODE,DATA_C,INITTAB=45B10000-45B1FFFF

-Z(CODE)PATCH_SWI=4430CE4C-4430CE53
-Z(CODE)LIB=45B20000-45B25000

// инициализация списков
-Z(CODE)PATCH_STANDBY_CALL=4527DB34-4527DB3B

// статическая рама
-Z(DATA)DATA_N=202FBFA4-202FCFA3

// cut print buffer first point
-Z(CODE)CUT_PRINT_BUF1=4423B524-4423B527
-Z(CODE)CUT_PRINT_BUF2=4423B788-4423B78B

// cut print buffer size
-Z(CODE)CUT_PRINT_BUF_SIZE1=4423B78C-4423B78F
-Z(CODE)CUT_PRINT_BUF_SIZE2=4423B444-4423B447
-Z(CODE)CUT_PRINT_BUF_SIZE3=4423B520-4423B523

// change keyhandler
-Z(CODE)OLD_KEY_HANDLER=20050984-20050987

// ассоциация elf
-Z(CODE)PATCH_DB1=44E8A5B8-44E8A5BF
-Z(CODE)PATCH_DB2=44E8A3A4-44E8A3AB
-Z(CODE)PATCH_DB3=44E8A220-44E8A227
-Z(CODE)PATCH_DB4=44E8AC0C-44E8AC13

// инициализация KbdHookList, Helper, Daemons
-Z(CODE)PATCH_AUTO_RUN=45AB90F4-45AB90F7
-Z(CODE)PATCH_AUTO_RUN1=45AB90F8-45AB90FB

//OseHook
-Z(CODE)PATCH_MMI_MESSAGE_HOOK=447B2D14-447B2D1B

// UIHook
-Z(CODE)PATCH_PageAction=45269898-4526989F

-carm
//C510_R1HA035
-Z(CODE)START,CODE,DATA_C,INITTAB=15D94000-15DB6FFF

-Z(CODE)PATCH_SWI=101CC930-101CC937
-Z(CODE)LIB=15D90000-15D93FFF

// инициализация списков
-Z(CODE)PATCH_STANDBY_CALL=14F738E4-14F738EB

// change keyhandler
-Z(CODE)OLD_KEY_HANDLER=4BA02A3C-4BA02A3F

// ассоциация elf
-Z(CODE)PATCH_DB1=142C7F14-142C7F1B
-Z(CODE)PATCH_DB2=142C85D4-142C85DB
-Z(CODE)PATCH_DB3=14F10B34-14F10B3B
-Z(CODE)PATCH_DB4=14F37808-14F3780F


// инициализация KbdHookList, Helper, Daemons
-Z(CODE)PATCH_AUTO_RUN=15BEFC70-15BEFC73
-Z(CODE)PATCH_AUTO_RUN1=15BEFC74-15BEFC7B

//OseHook
-Z(CODE)PATCH_MMI_MESSAGE_HOOK=10129BB4-10129BBB

//UIHook
-Z(CODE)PATCH_PageAction=1430DFE0-1430DFE7

// PageActionHook
-Z(CODE)PATCH_PageActionImpl=1430DD10-1430DD17

//Str2ID fix
-Z(CODE)PATCH_Str2ID=141818EE-141818EF

//int2strID fix
-Z(CODE)PATCH_int2strID=1401F5C2-1401F5C3
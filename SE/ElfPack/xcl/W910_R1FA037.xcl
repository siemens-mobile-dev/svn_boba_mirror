-carm

//W910_R1FA037
-Z(CODE)START,CODE,DATA_C,INITTAB=1222853C-12233FFF

-Z(CODE)PATCH_SWI=100EBB04-100EBB0B
-Z(CODE)LIB=122340A0-12237FFF

// инициализация списков
-Z(CODE)PATCH_STANDBY_CALL=115DE47C-115DE483

// change keyhandler
-Z(CODE)OLD_KEY_HANDLER=2A249C80-2A249C83

// ассоциация elf
-Z(CODE)PATCH_DB1=10FE424C-10FE4253
-Z(CODE)PATCH_DB2=10FE4058-10FE405F
-Z(CODE)PATCH_DB3=10FE3F18-10FE3F1F
-Z(CODE)PATCH_DB4=10FE4A28-10FE4A2F
-Z(CODE)PATCH_DB5=10FE40A4-10FE40AB
-Z(CODE)PATCH_DB6=10FE40D8-10FE40DF

// инициализация KbdHookList, Helper, Daemons
-Z(CODE)PATCH_AUTO_RUN=11B466A0-11B466A3
-Z(CODE)PATCH_AUTO_RUN1=11B466A4-11B466A7

//OseHook
-Z(CODE)PATCH_MMI_MESSAGE_HOOK=10721524-1072152B

// UIHook
-Z(CODE)PATCH_PageAction=115D1CC8-115D1CCF

// PageActionHook
-Z(CODE)PATCH_PageActionImpl=115D2214-115D221B
-carm
//C902_R3EG004AS
-Z(CODE)START,CODE,DATA_C,INITTAB=12680000-12687FFF

-Z(CODE)PATCH_SWI=1017AF00-1017AF07
-Z(CODE)LIB=1267C000-1267FFFF

// инициализация списков
-Z(CODE)PATCH_STANDBY_CALL=10D71580-10D71587

// change keyhandler
-Z(CODE)OLD_KEY_HANDLER=4BB7758C-4BB7758F

// ассоциация elf
-Z(CODE)PATCH_DB1=117CA914-117CA91B
-Z(CODE)PATCH_DB2=117CA71C-117CA723
-Z(CODE)PATCH_DB3=117CA5C4-117CA5CB
-Z(CODE)PATCH_DB4=117CAF90-117CAF97
-Z(CODE)PATCH_DB5=117CA768-117CA76F
-Z(CODE)PATCH_DB6=117CA79C-117CA7A3

// инициализация KbdHookList, Helper, Daemons
-Z(CODE)PATCH_AUTO_RUN=11F02500-11F02503
-Z(CODE)PATCH_AUTO_RUN1=11F02504-11F02507

//OseHook
-Z(CODE)PATCH_MMI_MESSAGE_HOOK=111F5D34-111F5D3B

// UIHook
-Z(CODE)PATCH_PageAction=10DD3504-10DD350B

// PageActionHook
-Z(CODE)PATCH_PageActionImpl=10DD3A4C-10DD3A53

//elfpackdata
-Z(CODE)EPD=4BB996F8-4BB996FB

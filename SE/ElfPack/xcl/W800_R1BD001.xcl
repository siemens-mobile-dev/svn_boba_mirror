-carm
//W800_R1BD001
-Z(CODE)START,CODE,DATA_C,INITTAB=451F8000-451FFFFF

-Z(CODE)PATCH_SWI=440670B4-440670BB
-Z(CODE)LIB=45200000-45204000


// инициализация списков
-Z(CODE)PATCH_STANDBY_CALL=44EA7690-44EA7697

// change keyhandler
-Z(CODE)OLD_KEY_HANDLER=4C05DD90-4C05DD93

// статическая рама
-Z(DATA)DATA_N=4C04B098-4C04B09B

// ассоциация elf
-Z(CODE)PATCH_DB2=450EBA84-450EBA87
-Z(CODE)PATCH_DB1=450EBBAC-450EBBAF


// инициализация KbdHookList, Helper, Daemons
-Z(CODE)PATCH_AUTO_RUN=4429CE04-4429CE07
-Z(CODE)PATCH_AUTO_RUN1=4429CE08-4429CE0B

//OseHook
-Z(CODE)PATCH_MMI_MESSAGE_HOOK=448F38BC-448F38C5

// UIHook
//-Z(CODE)PATCH_PageAction=4504D2B2-4504D2B5
-Z(CODE)PATCH_PageAction=4505B72C-4505B72F

// TabMenuBar check
-Z(CODE)PATCH_TabMenuCheck=44D3B690-44D3B697
-carm

//W910_R1FA035
-Z(CODE)START,CODE,DATA_C,INITTAB=1222B000-12236FFF

-Z(CODE)PATCH_SWI=100EBB04-100EBB0B
-Z(CODE)LIB=12227000-1222AFFF

// инициализация списков
-Z(CODE)PATCH_STANDBY_CALL=115DD104-115DD10B

// change keyhandler
-Z(CODE)OLD_KEY_HANDLER=2A249C80-2A249C83

// ассоциация elf
-Z(CODE)PATCH_DB1=10FE2ED4-10FE2EDB
-Z(CODE)PATCH_DB2=10FE2CE0-10FE2CE7
-Z(CODE)PATCH_DB3=10FE2BA0-10FE2BA7
-Z(CODE)PATCH_DB4=10FE36B0-10FE36B7
-Z(CODE)PATCH_DB5=10FE2D2C-10FE2D33
-Z(CODE)PATCH_DB6=10FE2D60-10FE2D67

// инициализация KbdHookList, Helper, Daemons
-Z(CODE)PATCH_AUTO_RUN=11B451EC-11B451EF
-Z(CODE)PATCH_AUTO_RUN1=11B451F0-11B451F3

//OseHook
-Z(CODE)PATCH_MMI_MESSAGE_HOOK=107202A0-107202A9

// UIHook
-Z(CODE)PATCH_PageAction=115D094C-115D0955
// PageActionHook
-Z(CODE)PATCH_PageActionImpl=115D0E9C-115D0EA3
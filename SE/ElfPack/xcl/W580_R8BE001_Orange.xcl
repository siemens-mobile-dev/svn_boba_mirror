-carm
//W580_R8BE001_Orange
-Z(CODE)START,CODE,DATA_C,INITTAB=45CF7000-45CFFFFF

-Z(CODE)PATCH_SWI=44307F24-44307F2C
-Z(CODE)LIB=45D00000-45D03FFF

// инициализация списков
-Z(CODE)PATCH_STANDBY_CALL=452FD1EC-452FD1F3

// change keyhandler
-Z(CODE)OLD_KEY_HANDLER=2004FE04-2004FE07

// ассоциация elf
-Z(CODE)PATCH_DB1=44EE5270-44EE5277
-Z(CODE)PATCH_DB2=44EE505C-44EE5063
-Z(CODE)PATCH_DB3=44EE4ED8-44EE4EE1
-Z(CODE)PATCH_DB4=44EE58C4-44EE58CB

// инициализация KbdHookList, Helper, Daemons
-Z(CODE)PATCH_AUTO_RUN=45BCDB58-45BCDB5B
-Z(CODE)PATCH_AUTO_RUN1=45BCDB5C-45BCDB5F

//OseHook
-Z(CODE)PATCH_MMI_MESSAGE_HOOK=447D5F54-447D5F5B

// UIHook
-Z(CODE)PATCH_PageAction=452E8D58-452E8D5F

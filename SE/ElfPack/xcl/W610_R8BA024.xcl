-carm
//W610_R8BA024
-Z(CODE)START,CODE,DATA_C,INITTAB=45C30000-45C3FFFF

-Z(CODE)PATCH_SWI=4430D1E8-4430D1F0
-Z(CODE)LIB=45C40000-45C44000

// инициализация списков
-Z(CODE)PATCH_STANDBY_CALL=452BE048-452BE04F

// статическая рама
-Z(DATA)DATA_N=202FCA14-2030CA13

// cut print buffer first point
-Z(CODE)CUT_PRINT_BUF1=4423B9FC-4423B9FF
-Z(CODE)CUT_PRINT_BUF2=4423BC60-4423BC63

// cut print buffer size
-Z(CODE)CUT_PRINT_BUF_SIZE1=4423BC64-4423BC67
-Z(CODE)CUT_PRINT_BUF_SIZE2=4423B91C-4423B91F
-Z(CODE)CUT_PRINT_BUF_SIZE3=4423B9F8-4423B9FB

// change keyhandler
-Z(CODE)OLD_KEY_HANDLER=20050F28-20050F2B

// ассоциация elf
-Z(CODE)PATCH_DB1=44EBC110-44EBC117
-Z(CODE)PATCH_DB2=44EBBEFC-44EBBF03
-Z(CODE)PATCH_DB3=44EBBD78-44EBBD81
-Z(CODE)PATCH_DB4=44EBC764-44EBC76B

// инициализация KbdHookList, Helper, Daemons
-Z(CODE)PATCH_AUTO_RUN=45A50758-45A5075B
-Z(CODE)PATCH_AUTO_RUN1=45A5075C-45A5075F

//OseHook
-Z(CODE)PATCH_MMI_MESSAGE_HOOK=447C7E20-447C7E27

// UIHook
-Z(CODE)PATCH_PageAction=452A9D9C-452A9DA3

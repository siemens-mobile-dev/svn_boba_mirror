-carm
//W610_R8BA024
-Z(CODE)START,CODE,DATA_C,INITTAB=45C30000-45C3FFFF

-Z(CODE)PATCH_SWI=4430D1E8-4430D1F0
-Z(CODE)LIB=45C40000-45C44000

// инициализация списков
-Z(CODE)PATCH_STANDBY_CALL=452BE048-452BE04F

// change keyhandler
-Z(CODE)OLD_KEY_HANDLER=20050F28-20050F2B

// ассоциация elf
-Z(CODE)PATCH_DB1=44EBC110-44EBC117
-Z(CODE)PATCH_DB2=44EBBEFC-44EBBF03
-Z(CODE)PATCH_DB3=44EBBD78-44EBBD81
-Z(CODE)PATCH_DB4=44EBC764-44EBC76B

// инициализация KbdHookList, Helper, Daemons
-Z(CODE)PATCH_AUTO_RUN=45A50758-45A5075B
-Z(CODE)PATCH_AUTO_RUN1=45A5075C-45A5075F

//OseHook
-Z(CODE)PATCH_MMI_MESSAGE_HOOK=447C7E20-447C7E27

// UIHook
-Z(CODE)PATCH_PageAction=452A9D9C-452A9DA3

// PageActionHook
-Z(CODE)PATCH_PageActionImpl=452AA37C-452AA383
-carm
//Z550_R6GA004
-Z(CODE)START,CODE,DATA_C,INITTAB=456B8000-456BFFFF

-Z(CODE)PATCH_SWI=4418269C-441826A3
-Z(CODE)LIB=456C0000-456C4000


// инициализация списков
-Z(CODE)PATCH_STANDBY_CALL=452677F4-452677FB

// change keyhandler
-Z(CODE)OLD_KEY_HANDLER=4C0453D0-4C0453D3

// ассоциация elf
-Z(CODE)PATCH_DB2=4556EB80-4556EB83
-Z(CODE)PATCH_DB1=4556EC8E-4556EC91

// инициализация KbdHookList, Helper, Daemons
-Z(CODE)PATCH_AUTO_RUN=4455906C-4455906F
-Z(CODE)PATCH_AUTO_RUN1=44559070-44559073

//OseHook
-Z(CODE)PATCH_MMI_MESSAGE_HOOK=44B8B278-44B8B281

// UIHook
-Z(CODE)PATCH_PageAction=454E55C4-454E55C7

// PageActionHook
-Z(CODE)PATCH_PageActionImpl=454E51B0-454E51B7
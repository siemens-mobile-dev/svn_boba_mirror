-carm
//W610_R6CA001_Orange
-Z(CODE)START,CODE,DATA_C,INITTAB=45C30000-45C3FFFF

-Z(CODE)PATCH_SWI=4430C9F0-4430C9F8
-Z(CODE)LIB=45C40000-45C44000

// инициализация списков
-Z(CODE)PATCH_STANDBY_CALL=452EDC18-452EDC1F

// change keyhandler
-Z(CODE)OLD_KEY_HANDLER=20050E64-20050E67

// ассоциация elf
-Z(CODE)PATCH_DB1=44EE7B24-44EE7B2B
-Z(CODE)PATCH_DB2=44EE7910-44EE7917
-Z(CODE)PATCH_DB3=44EE778C-44EE7793
-Z(CODE)PATCH_DB4=44EE8178-44EE817F

// инициализация KbdHookList, Helper, Daemons
-Z(CODE)PATCH_AUTO_RUN=45A70C94-45A70C97
-Z(CODE)PATCH_AUTO_RUN1=45A70C98-45A70C9B

//OseHook
-Z(CODE)PATCH_MMI_MESSAGE_HOOK=447CDD74-447CDD7B

// UIHook
-Z(CODE)PATCH_PageAction=452D9A20-452D9A28

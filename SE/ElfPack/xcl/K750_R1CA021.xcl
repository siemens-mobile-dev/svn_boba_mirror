-carm
//K750_R1CA021
-Z(CODE)START,CODE,DATA_C,INITTAB=451CB900-451CFFFF

-Z(CODE)PATCH_SWI=44067098-4406709F
-Z(CODE)LIB=451D0000-451D4000


// инициализация списков
-Z(CODE)PATCH_STANDBY_CALL=44E9ED88-44E9ED8F

// change keyhandler
-Z(CODE)OLD_KEY_HANDLER=4C05DD60-4C05DD63

// ассоциация elf
-Z(CODE)PATCH_DB2=450DD888-450DD88B
-Z(CODE)PATCH_DB1=450DD9B0-450DD9B3
//-Z(CODE)PATCH_DB_INT=44234FB4-44234FB7
//-Z(CODE)PATCH_DB_EXT=44234FB8-44234FBb
//-Z(CODE)PATCH_DB_FOLDERS=4518E5FC-4518E5FF

//-Z(CODE)PATCH_DB_THEME_HEADER=44E20E18-44E20E1B
//-Z(CODE)PATCH_DB_THEME_ITEM=4518E5D8-4518E5DB


// инициализация KbdHookList, Helper, Daemons
-Z(CODE)PATCH_AUTO_RUN=4429C7FC-4429C7FF
-Z(CODE)PATCH_AUTO_RUN1=4429C800-4429C803

//OseHook
-Z(CODE)PATCH_MMI_MESSAGE_HOOK=44AD4C80-44AD4C89

// UIHook
//-Z(CODE)PATCH_PageAction=4504D2B2-4504D2B5
-Z(CODE)PATCH_PageAction=4504D61C-4504D61F

// PageActionHook
-Z(CODE)PATCH_PageActionImpl=4504D2CC-4504D2D3

// TabMenuBar check
-Z(CODE)PATCH_TabMenuCheck=44D315AC-44D315B3
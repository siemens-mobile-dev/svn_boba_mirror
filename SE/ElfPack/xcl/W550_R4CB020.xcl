-carm
//W550_R4CB020
-Z(CODE)START,CODE,DATA_C,INITTAB=45618000-4561FFFF//4561FFFF

-Z(CODE)PATCH_SWI=440E6724-440E672B
-Z(CODE)LIB=45620000-45624000


// инициализация списков
-Z(CODE)PATCH_STANDBY_CALL=451D4438-451D443F

// change keyhandler
-Z(CODE)OLD_KEY_HANDLER=4C0467DC-4C0467DF

// ассоциация elf
-Z(CODE)PATCH_DB2=454E971C-454E971F
-Z(CODE)PATCH_DB1=454E982A-454E982D

// инициализация KbdHookList, Helper, Daemons
-Z(CODE)PATCH_AUTO_RUN=444C2D00-444C2D03
-Z(CODE)PATCH_AUTO_RUN1=444C2D04-444C2D07

//OseHook
-Z(CODE)PATCH_MMI_MESSAGE_HOOK=44B0B378-44B0B381

// UIHook
//-Z(CODE)PATCH_PageAction=45453F9E-45453FA1
-Z(CODE)PATCH_PageAction=454543CC-454543CF

// PageActionHook
-Z(CODE)PATCH_PageActionImpl=45453FB8-45453FBF
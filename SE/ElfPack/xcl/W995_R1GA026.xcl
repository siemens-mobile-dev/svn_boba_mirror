-carm
//W995_R1GA026
-Z(CODE)START,CODE,DATA_C,INITTAB=15EC0000-15ECFFFF

-Z(CODE)PATCH_SWI=101E1404-101E140B // ;pAtChFiLe=/boot/phone_emp_app.cxc

-Z(CODE)LIB=15ED0000-15ED4000

// инициализация списков
-Z(CODE)PATCH_STANDBY_CALL=14E2EA70-14E2EA77

//UIHook
-Z(CODE)PATCH_PageAction=14104350-14104357

//OseHook
-Z(CODE)PATCH_MMI_MESSAGE_HOOK=101368C4-101368CB // ;pAtChFiLe=/boot/phone_emp_app.cxc

// change keyhandler
-Z(CODE)OLD_KEY_HANDLER=4BA02C68-4BA02C6B

// инициализация KbdHookList, Helper, Daemons
-Z(CODE)PATCH_AUTO_RUN=15D0A3B0-15D0A3B3
-Z(CODE)PATCH_AUTO_RUN1=15D0A3B4-15D0A3B7

// ассоциация elf
-Z(CODE)PATCH_DB1=142DBAC4-142DBACB
-Z(CODE)PATCH_DB2=142DB6CC-142DB6D3
-Z(CODE)PATCH_DB3=14FEDCB4-14FEDCBB
-Z(CODE)PATCH_DB4=14FC5178-14FC517F

-carm
//C901_R1GA028
-Z(CODE)START,CODE,DATA_C,INITTAB=15D8D000-15DAFFFF

-Z(CODE)PATCH_SWI=101CB5AC-101CB5B3

-Z(CODE)LIB=15D89000-15D8CFFF

// инициализация списков
-Z(CODE)PATCH_STANDBY_CALL=14D751D4

//UIHook
-Z(CODE)PATCH_PageAction=14103884

//OseHook
-Z(CODE)PATCH_MMI_MESSAGE_HOOK=10128FB0

// change keyhandler
-Z(CODE)OLD_KEY_HANDLER=4BA02C24-4BA02C27

// инициализация KbdHookList, Helper, Daemons
-Z(CODE)PATCH_AUTO_RUN=15BD40B0
-Z(CODE)PATCH_AUTO_RUN1=15BD40B4

// ассоциация elf
-Z(CODE)PATCH_DB1=142DA980
-Z(CODE)PATCH_DB2=142DA588
-Z(CODE)PATCH_DB3=14F349FC
-Z(CODE)PATCH_DB4=14F0BEAC

// PageActionHook
-Z(CODE)PATCH_PageActionImpl=14103338-1410333F

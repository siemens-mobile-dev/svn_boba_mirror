-carm
//C510_R1FA035
-Z(CODE)START,CODE,DATA_C,INITTAB=15CE9000-15D0BFFF

-Z(CODE)PATCH_SWI=101CCC60-101CCC67
-Z(CODE)LIB=15CE5000-15CE8FFF

// инициализация списков
-Z(CODE)PATCH_STANDBY_CALL=14F62FFC

// change keyhandler
-Z(CODE)PATCH_KEYHANDLER1=141C3D7C-141C3D83
-Z(CODE)PATCH_KEYHANDLER2=141C4090-141C4097
-Z(CODE)PATCH_KEYHANDLER3=1449A190-1449A197

// ассоциация elf
-Z(CODE)PATCH_DB1=142C4A9C
-Z(CODE)PATCH_DB2=142C43DC
-Z(CODE)PATCH_DB3=14F27668
-Z(CODE)PATCH_DB4=14F006E4


// инициализация KbdHookList, Helper, Daemons
-Z(CODE)PATCH_AUTO_RUN=15BCE0B0
-Z(CODE)PATCH_AUTO_RUN1=15BCE0B4

//OseHook
-Z(CODE)PATCH_MMI_MESSAGE_HOOK=10129A00

// PageActionHook
-Z(CODE)PATCH_PageActionImpl_All=14309F40-14309F47
-Z(CODE)PATCH_PageActionImpl_EnterExit=1447BEE4-1447BEEB

//elfpackdata
-Z(CODE)EPD=4BAFF47C-4BAFF47F

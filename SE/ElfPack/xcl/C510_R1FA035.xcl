-carm
//C510_R1FA035
-Z(CODE)START,CODE,DATA_C,INITTAB=15CE5000-15CEBFFF

-Z(CODE)PATCH_SWI=101CCC60-101CCC67
-Z(CODE)LIB=15CEC000-15D0BFFF

// инициализация списков
-Z(CODE)PATCH_STANDBY_CALL=14F62FFC

// change keyhandler
-Z(CODE)OLD_KEY_HANDLER=4BA02C24-4BA02C27

// ассоциация elf
-Z(CODE)PATCH_DB1=142C4A9C
-Z(CODE)PATCH_DB2=142C43DC
-Z(CODE)PATCH_DB3=14F27668
-Z(CODE)PATCH_DB4=14F006E4
//-Z(CODE)PATCH_DB5=11856494
//-Z(CODE)PATCH_DB6=118564C8

// инициализация KbdHookList, Helper, Daemons
-Z(CODE)PATCH_AUTO_RUN=15BCE0B0
-Z(CODE)PATCH_AUTO_RUN1=15BCE0B4

//OseHook
-Z(CODE)PATCH_MMI_MESSAGE_HOOK=10129A00

//UIHook
-Z(CODE)PATCH_PageAction=1430A070

-carm
//W710_R1JC002
-Z(CODE)START,CODE,DATA_C,INITTAB=45C30000-45C3FFFF

-Z(CODE)PATCH_SWI=4430A5BC-4430A5C4
-Z(CODE)LIB=45C40000-45C44000

// инициализация списков
-Z(CODE)PATCH_STANDBY_CALL=4529DD28-4529DD2F

// статическая рама
-Z(DATA)DATA_N=20474780-2048477F

// cut print buffer first point
-Z(CODE)CUT_PRINT_BUF1=4423A01C-4423A01F
-Z(CODE)CUT_PRINT_BUF2=4423A280-4423A283

// cut print buffer size
-Z(CODE)CUT_PRINT_BUF_SIZE1=4423A284-4423A287
-Z(CODE)CUT_PRINT_BUF_SIZE2=44239F3C-44239F3F 
-Z(CODE)CUT_PRINT_BUF_SIZE3=4423A018-4423A01B

// change keyhandler
-Z(CODE)OLD_KEY_HANDLER=2004AC9C-2004AC9F

// ассоциация elf
-Z(CODE)PATCH_DB1=44E9B524-44E9B52B 
-Z(CODE)PATCH_DB2=44E9B30C-44E9B315
-Z(CODE)PATCH_DB3=44E9B18C-44E9B195
-Z(CODE)PATCH_DB4=44E9BB7C-44E9BB85

// инициализация KbdHookList, Helper, Daemons
-Z(CODE)PATCH_AUTO_RUN=45A55284-45A55287
-Z(CODE)PATCH_AUTO_RUN1=45A55288-45A5528B

//OseHook
-Z(CODE)PATCH_MMI_MESSAGE_HOOK=4479A3F8-4479A3FF

// UIHook
-Z(CODE)PATCH_PageAction=45288FB0-45288FB7

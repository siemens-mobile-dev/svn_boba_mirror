-carm
//W705_R1GA031
-Z(CODE)START,CODE,DATA_C,INITTAB=15CE8000-15CEFFFF

-Z(CODE)PATCH_SWI=101CB738-101CB73F
-Z(CODE)LIB=15CE4000-15CE7FFF

// инициализация списков
-Z(CODE)PATCH_STANDBY_CALL=14FA81C8-14FA81CF

// change keyhandler
-Z(CODE)OLD_KEY_HANDLER=4BA02C5C-4BA02C5F

// ассоциация elf
-Z(CODE)PATCH_DB1=142CC4AC-142CC4B3
-Z(CODE)PATCH_DB2=142CCB6C-142CCB73
-Z(CODE)PATCH_DB3=14F449F4-14F449FB
-Z(CODE)PATCH_DB4=14F6BEA8-14F6BEAF


// инициализация KbdHookList, Helper, Daemons
-Z(CODE)PATCH_AUTO_RUN=15BCE774-15BCE777
-Z(CODE)PATCH_AUTO_RUN1=15BCE778-15BCE77B

//OseHook
-Z(CODE)PATCH_MMI_MESSAGE_HOOK=101290DC-101290E3

// UIHook
-Z(CODE)PATCH_PageAction=14312BE8-14312BEF

// PageActionHook
-Z(CODE)PATCH_PageActionImpl=14312928-1431292F

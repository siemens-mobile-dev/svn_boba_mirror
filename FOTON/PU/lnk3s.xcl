
-!                      - lnk3s.xcl -

    XLINK command file for the ICCA90 C-compiler using the -v3, -ms options.
    Segments are defined for a generic AT90S with a maximum of
     64 Kbytes data address space and 128 Kbytes program address space.

    Usage: xlink your_file(s) -f lnk3s

    File version:   $Revision: 1.12 $

    The following segments are used by the compiler:

    Program address space read only segments (internal Flash)
    =========================================================
    segment     address range  max size (dec)  used with compiler options    
    -------     -------------  --------------  --------------------------    
    INTVEC          0 -    1F   32 bytes       -e ("interrupt" keyword)      
    RCODE          20 -   FFF    4 Kbytes     
    SWITCH         20 -  FFFF   64 Kbytes     
    FLASH          20 -  FFFF   64 Kbytes      -e ("flash" keyword)          
    CDATA0         20 - 1FFFF  128 Kbytes      -e ("tiny" keyword)           
    CDATA1         20 - 1FFFF  128 Kbytes      (if -y then const objects)    
    CCSTR          20 - 1FFFF  128 Kbytes      -y                            
    CODE           20 - 1FFFF  128 Kbytes     

    Data address space read only segments (external PROM)
    =====================================================
    segment     address range  max size (dec)  used with compiler options    
    -------     -------------  --------------  --------------------------    
    CONST           ? -  FFFF   64 Kbytes      Not -y                        
    CSTR            ? -  FFFF   64 Kbytes      Not -y                        

    Data address space read/write segments 
    ==============================================================
    segment     address range  max size (dec)  used with compiler options    
    -------     -------------  --------------  --------------------------    
    UDATA0         60 -    FF  224 bytes       -e ("tiny" keyword)           
    IDATA0         60 -    FF  224 bytes       -e ("tiny" keyword)           
    RSTACK         60 -  FFFF   64 Kbytes     
    CSTACK         60 -  FFFF   64 Kbytes      
    UDATA1         60 -  FFFF   64 Kbytes                                    
    IDATA1         60 -  FFFF   64 Kbytes      (if -y then const objects)    
    ECSTR          60 -  FFFF   64 Kbytes      -y                            

    Data address space read/write non-volatile segments (external EEPROM)
    =====================================================================
    segment     address range  max size (dec)  used with compiler options    
    -------     -------------  --------------  --------------------------    
    NO_INIT        60 -  FFFF   64 Kbytes      -e ("no_init" keyword)        

   "tiny" pointers can only access objects in the range 0-FF.
    Option -y stores strings in ECSTR (init value in CCSTR) instead of CSTR,
    and stores constants in IDATA1 (init value in CDATA1).
-!

-!  First define CPU -!

-ca90

-! Program address space (internal Flash memory) -!
-Z(CODE)INTVEC=0-FF
-Z(CODE)RCODE,CDATA0,CDATA1,CCSTR,SWITCH,FLASH,CSTR,CODE=100-FFFD
-Z(CODE)CHECKSUM=7FFE-7FFF

-! Data address space -!
-! The registers are in 0-1F and memmory mapped I/O in 20-5F -!
-Z(DATA)IDATA0,UDATA0=60-FF

-! Return address stack -!

-! Select if the return address stack is in external RAM or in internal SRAM -!
-e?RSTACK_IN_EXTERNAL_RAM=?C_STARTUP

-! Select if the return address stack is in external RAM or in internal SRAM -!
-! -e?RSTACK_IN_EXTERNAL_SRAM=?C_STARTUP -!

-Z(DATA)RSTACK+100=100-200

-! Near memory  -!
-Z(DATA)CSTACK+400,IDATA1,UDATA1,ECSTR,NO_INIT,CONST=200-0FFF
-! Data address space (external EEPROM) -!

-! Data address space (external PROM) -!
-! 
    If Motorola S-records are produced (-Fmotorola), then the next line
    should be changed by adding a value >= 100000 to the addresses,
    and DATA is changed to NEAR, e.g.
        -Z(NEAR)CSTR,CONST=109000-10FFFF
    This will avoid overlap between the program and data address spaces.
-!

-!  Select reduced "printf" support to reduce library size.
    See configuration section in manual concerning printf/sprintf. -!

-! -e_small_write=_formatted_write -!
-! -e_small_write_P=_formatted_write_P -!
-e_medium_write=_formatted_write
-e_medium_write_P=_formatted_write_P

-!  Disable floating-point support in "scanf" to reduce library size.
    See configuration section in manual concerning scanf/sscanf -!

-e_medium_read=_formatted_read
-e_medium_read_P=_formatted_read_P

-! Suppress one warning which is not relevant for this processor -!
-w29

-!  Now load the 'C' library -!

cl3s

-! Code will now reside in file aout.a90 or aout.d90, unless -o is specified -!
-! .d90 is the default if debug system is linked (option -r) -!
-! .a90 is the default without debugging. Default format is -Fmotorola -!
